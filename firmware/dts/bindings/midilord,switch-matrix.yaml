## firmware/dts/bindings/midilord,switch-matrix.yaml
```yaml
description: Midilord footswitch matrix

compatible: "midilord,switch-matrix"

properties:
  row-gpios:
    type: phandle-array
    required: true

  col-gpios:
    type: phandle-array
    required: true
```
