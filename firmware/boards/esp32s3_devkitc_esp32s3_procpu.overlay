#include <zephyr/dt-bindings/gpio/gpio.h>

/ {
    chosen {
        zephyr,console = &usb_serial;
    };
    switches {
        compatible = "midilord,switch-matrix";

        row-gpios = <&gpio0 1 GPIO_ACTIVE_HIGH>,
                    <&gpio0 2 GPIO_ACTIVE_HIGH>;

        col-gpios = <&gpio1 7 GPIO_ACTIVE_HIGH>,
                    <&gpio1 8 GPIO_ACTIVE_HIGH>,
                    <&gpio1 9 GPIO_ACTIVE_HIGH>,
                    <&gpio1 10 GPIO_ACTIVE_HIGH>;
    };
};

&usb_serial {
    status = "okay";
};
